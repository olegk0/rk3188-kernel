## drivers/gpu/hx170_dec/Kconfig
```kconfig
menuconfig HX170_DEC
	tristate "HX170 Video decoder"
	default n
	help
	  HX170 Video decoder.
```

## drivers/gpu/mali/Kconfig
```kconfig
menuconfig MALI
	tristate "ARM Mali GPU modules"
	depends on ARM
        select UMP
        select MALI400
	default n
	help
	  This enables the generation of mali.ko and ump.ko.

source "drivers/gpu/mali/mali/Kconfig"
source "drivers/gpu/mali/ump/Kconfig"
source "drivers/gpu/mali/rk_ump/Kconfig"
```

## drivers/gpu/mali/rk_ump/Kconfig
```kconfig
menuconfig RK_UMP
	tristate "RK UMP memory allocator"
	depends on IAM_CHANGES && UMP
	default n
	help
	  RK UMP memory allocator.

config MM_BUF_SIZE
	int "Size of multimedia buffer for rk_ump (Mb)"
	depends on RK_UMP
	default 64
	help
	  Size of multimedia buffer for rk_ump (Mb).
```
